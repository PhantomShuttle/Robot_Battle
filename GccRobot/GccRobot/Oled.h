//sbit OLED_SPI_SDIN_H=P0^6;				//SPI通信数据线
//sbit OLED_SPI_SCLK=P0^1;                //SPI通信时钟线
//sbit OLED_SPI_DC=P0^2;					//SPI通信命令数据选择
//sbit OLED_SPI_RST=P0^3;                 //OLED复位引脚
// Define I/O pins
#include <avr/interrupt.h>
#define BIT7 0x80
#define BIT6 0x40
#define BIT5 0x20
#define BIT4 0x10
#define BIT3 0x08
#define BIT2 0x04
#define BIT1 0x02
#define BIT0 0x01

#define uchar unsigned char
#define uint unsigned int
#define OLED_CMD 	0	//写命令
#define OLED_DATA 	1	//写数据

#define BIT(x)	       (1 << (x))
#define SETBIT(x, y)   (x |= y)
#define CLEARBIT(x, y) (x &= ~y)
#define CHECKBIT(x, y) (x & y)

#define OLED_SPI_SDIN  BIT2
#define OLED_SPI_SCLK BIT3
#define OLED_SPI_DC  BIT0
#define OLED_SPI_RST BIT1

#define OLED_SPI_SDIN_H 	SETBIT(PORTC, OLED_SPI_SDIN )	//SPI通信数据线
#define OLED_SPI_SDIN_L 	CLEARBIT(PORTC, OLED_SPI_SDIN)	//SPI通信数据线
#define OLED_SPI_SCLK_H     SETBIT(PORTC, OLED_SPI_SCLK )          //SPI通信时钟线
#define OLED_SPI_SCLK_L     CLEARBIT(PORTC, OLED_SPI_SCLK)          //SPI通信时钟线
#define OLED_SPI_DC_H       SETBIT(PORTC, OLED_SPI_DC )
#define OLED_SPI_DC_L       CLEARBIT(PORTC, OLED_SPI_DC)
#define  OLED_SPI_RST_H     SETBIT(PORTC, OLED_SPI_RST )
#define  OLED_SPI_RST_L     CLEARBIT(PORTC, OLED_SPI_RST)


void Delay_ms(uint);
void OledWriteByte(uchar ,uchar );
void OledClearn(void);

/*SSD1306 基础命令定义*/
#define SET_CONTRAST_CONTROL		0x81		//对比度设置命令，取值范围1-255，复位值：0x7F
#define SET_DISPLAY_ON				0xAF		//开显示命令
#define SET_DISPLAY_OFF				0xAE		//关显示命令
#define ENTIRE_DISPLAY_ON_A4		0xA4		//全局显示关闭
#define ENTIRE_DISPLAY_ON_A5		0xA5		//全局显示开启
#define NORMAL_DISPLAY				0xA6		//给GDDRAM值为0，熄灭像素；给GDDRAM值为1，点亮像素
#define INVERSE_DISPLAY				0xA7		//给GDDRAM值为0，点亮像素；给GDDRAM值为1，熄灭像素

/*SSD1306 滚动显示命令定义*/
#define HORIZONTAL_SCROLL_SETUP_RIGHT	0x26	//向右水平移动
#define HORIZONTAL_SCROLL_SETUP_LEFT	0x27	//向左水平移动
#define HORIZONTAL_SCROLL_SETUP_AE		0x00	//配置水平移动时，需要的虚拟字节
#define HORIZONTAL_SCROLL_SETUP_F		0xFF	//配置水平移动时，需要的虚拟字节
#define ACTIVATE_SCROLL					0x2F	//开启滚动显示功能
#define DEACTIVATE_SCROLL				0x2E	//关闭滚动显示功能
#define SET_VERTICAL_SCROLL_AREA		0xA3	//设置垂直滚动范围命令
#define HV_SCROLL_SRTEP_RIGHT			0x29	//向右水平移动
#define HV_SCROLL_SRTEP_LEFT			0x2A	//向左水平移动

/*SSD1306 地址设置命令定义*/
#define SET_MEMORY_ADDR_MODE			0x20	//设置地址模式：0x00,列地址模式；0x01,行地址模式；0x10，页地址模式

/*SSD1306 硬件配置命令定义*/
#define SET_SEGMENT_REMAP_A0			0xA0	//列地址0映射到SEG0
#define SET_SEGMENT_REMAP_A1			0xA1	//列地址0映射到SEG127
#define SET_MULTIPLEX_RATIO				0xA8	//设置驱动路数
#define SET_COM_SCAN_DIRECTION_C0		0xC0	//扫描方向从COM0-->COM[N-1]
#define SET_COM_SCAN_DIRECTION_C8		0xC8	//扫描方向从COM[N-1]-->COM0
#define SET_DISPLAY_OFFSET				0xD3	//设置行显示偏移
#define SET_COM_PINS_CONFIG				0xDA	//设置COM硬件引脚配置命令

/*SSD1306 显示时钟和驱动相关命令定义*/
#define SET_DISPLAY_CLOCK				0xD5	//设置时钟分频因子、振荡频率
#define SET_PRECHARGE_PERIOD			0xD9	//设置预充电周期
#define SET_VCOMH_DESELECT_L			0xDB	//设置VCOMH电源倍率
#define CHARGE_PUMP_SET					0x8D	//电荷泵设置

unsigned char  ASCII_1608[][16]={
	{0x00,0x00,0x00,0x00,0x00,0x00,0x00,0x00,0x00,0x00,0x00,0x00,0x00,0x00,0x00,0x00},/*" ",0*/
	{0x00,0x00,0x00,0xF8,0x00,0x00,0x00,0x00,0x00,0x00,0x00,0x33,0x30,0x00,0x00,0x00},/*"!",1*/
	{0x00,0x10,0x0C,0x06,0x10,0x0C,0x06,0x00,0x00,0x00,0x00,0x00,0x00,0x00,0x00,0x00},/*""",2*/
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	{0x00,0x06,0x01,0x01,0x02,0x02,0x04,0x04,0x00,0x00,0x00,0x00,0x00,0x00,0x00,0x00}/*"~",94*/
};



void delay_1us(void)    //1us延时函数
{
	unsigned int i;
	for(i=0;i<1200;i++);
}

void Delay_ms(uint z)
{
	uint x,y;
	for(x=0;x<z;x++)
	for(y=0;y<1201;y++);
}

void OledWriteByte(uchar wbyte,uchar cmd)
{
	uchar i;
	if (cmd==1)
	{OLED_SPI_DC_H;
	}
	else
	{OLED_SPI_DC_L;
	}
	//OLED_SPI_DC=cmd;
	for(i=0;i<8;i++)
	{   OLED_SPI_SCLK_L;
		//OLED_SPI_SCLK=0;
		if(wbyte&0x80)
		{
			OLED_SPI_SDIN_H;
			//OLED_SPI_SDIN=1;
		}
		else
		{
			OLED_SPI_SDIN_L;
			//OLED_SPI_SDIN=0;
		}
		OLED_SPI_SCLK_H;
		//OLED_SPI_SCLK=1;
		wbyte<<=1;
		delay_1us();
	}
}
void OledClearn(void)
{
	uchar i,j;

	for(i=0;i<8;i++)
	{
		OledWriteByte(0xb0+i,OLED_CMD);				//设置页地址
		OledWriteByte(0x00,OLED_CMD);				//设置列低地址
		OledWriteByte(0x10,OLED_CMD);				//设置列高地址

		for(j=0;j<128;j++)
		{
			OledWriteByte(0x00,OLED_DATA);
		}

	}
}
void OledFullDisp(void)
{
	uchar i,j;

	for(i=0;i<8;i++)
	{
		OledWriteByte(0xb0+i,OLED_CMD);				//设置页地址
		OledWriteByte(0x00,OLED_CMD);				//设置列低地址
		OledWriteByte(0x10,OLED_CMD);				//设置列高地址

		for(j=0;j<128;j++)
		{
			OledWriteByte(0xFF,OLED_DATA);
		}
	}
}
void OledInit(void)
{
	/*OLED复位*/
	OLED_SPI_RST_L;
	//OLED_SPI_RST=0;
	delay_1us();
	OLED_SPI_RST_H;
	//OLED_SPI_RST=1;
	delay_1us();

	/*关闭OLED显示*/
	OledWriteByte(SET_DISPLAY_OFF,OLED_CMD);
	
	/*设置正当频率、时钟分频因子*/
	OledWriteByte(SET_DISPLAY_CLOCK,OLED_CMD);
	OledWriteByte(0x80,OLED_CMD);
	
	/*设置驱动路数*/
	OledWriteByte(SET_MULTIPLEX_RATIO,OLED_CMD);			  //驱动路数设置命令
	OledWriteByte(0x3F,OLED_CMD);							  //驱动路数值

	/*设置行显示偏移*/
	OledWriteByte(SET_DISPLAY_OFFSET,OLED_CMD);				  //显示偏移设置命令
	OledWriteByte(0x00,OLED_CMD);							  //取值范围：0x00-->0x3F

	/*设置显示起始行*/
	OledWriteByte(0x40,OLED_CMD);							  //取值范围：0x40---0x7F
	
	/*设置电荷泵*/
	OledWriteByte(CHARGE_PUMP_SET,OLED_CMD); 				  //电荷泵设置命令
	OledWriteByte(0x14,OLED_CMD);							  //开启电荷泵

	/*设置内存地址模式*/
	OledWriteByte(SET_MEMORY_ADDR_MODE,OLED_CMD);			  //内存地址模式设置命令
	OledWriteByte(0x10,OLED_CMD);							  //设置地址模式值：0x00,列地址模式；0x01,行地址模式；
	//0x10，页地址模式；
	/*设置列地址映射*/
	OledWriteByte(SET_SEGMENT_REMAP_A1,OLED_CMD); 			  //列地址0映射到SEG127

	/*设置行地址映射*/
	OledWriteByte(SET_COM_SCAN_DIRECTION_C8,OLED_CMD); 		  //行地址0映射到COM63
	
	/*设置COM硬件引脚配置*/
	OledWriteByte(SET_COM_PINS_CONFIG,OLED_CMD); 			  //设置COM硬件引脚配置命令
	OledWriteByte(0x12,OLED_CMD);

	/*对比度设置*/
	OledWriteByte(SET_CONTRAST_CONTROL,OLED_CMD); 			   //对比度设置命令
	OledWriteByte(0x8F,OLED_CMD); 							   //对比度值，取值范围1-255
	
	/*设置预充电周期*/
	OledWriteByte(SET_PRECHARGE_PERIOD,OLED_CMD);
	OledWriteByte(0xF1,OLED_CMD);
	
	/*设置VCOMH电源倍率*/
	OledWriteByte(SET_VCOMH_DESELECT_L,OLED_CMD);
	OledWriteByte(0x30,OLED_CMD);

	/*关闭全局显示*/
	OledWriteByte(ENTIRE_DISPLAY_ON_A4,OLED_CMD);

	/*设置OLED点亮方式*/
	OledWriteByte(NORMAL_DISPLAY,OLED_CMD); 	 				//0：熄灭像素；1：点亮像素

	/*打开OLED显示*/
	OledWriteByte(SET_DISPLAY_ON,OLED_CMD);
	
	/*清屏操作*/
	OledClearn();
}
void xianshi1(char Digitchar ,char y,char x)
{uchar i,j,addyl,addyh;
	uchar *databuf;
	

	databuf=(uchar *)(ASCII_1608+Digitchar+16);
	
	/*计算当前字符显示的起始列地址*/
	addyl=x%16;										//计算列低地址
	addyh=x/16+0x10;								//计算列高地址

	/*显示字符*/
	for(i=0;i<2;i++)
	{
		OledWriteByte(0xb0+y+i,OLED_CMD);			//设置页地址
		OledWriteByte(addyl,OLED_CMD);				//设置列低地址
		OledWriteByte(addyh,OLED_CMD);				//设置列高地址

		for(j=0;j<8;j++)
		{
			OledWriteByte(*(databuf++),OLED_DATA);
		}
	}


	
}

void Cache_MDigit(int Digit,char y,char x,char i )//2位数 y0-7 x0-127
{unsigned int d0,d1;

	d0=Digit/10;
	Digit=Digit-d0*10;
	d1=Digit%10;
	
	xianshi1(d0,y,x);
	xianshi1(d1,y,x+6+i);
}
void Cache_MDigit5(uint Digit,char y,char x,char i )//5位数 y0-7 x0-127
{unsigned int d0,d1,d2,d3,d4;

	d0=Digit/10000;
	Digit=Digit-d0*10000;
	d1=Digit/1000;
	Digit=Digit-d1*1000;
	d2=Digit/100;
	Digit=Digit-d2*100;
	d3=Digit/10;
	Digit=Digit-d3*10;
	d4=Digit%10;
	
	xianshi1(d0,y,x);
	xianshi1(d1,y,x+6+i);
	xianshi1(d2,y,x+(6+i)*2);
	xianshi1(d3,y,x+(6+i)*3);
	xianshi1(d4,y,x+(6+i)*4);
}
void Cache_MDigit5_int(int Digit,char y,char x,char i )//5位数 y0-7 x0-127
{int d0,d1,d2,d3,d4;
	if (Digit<0)
	{xianshi1(-3,y,x);
		Digit=-Digit;
	}
	else{xianshi1(-5,y,x);}
	d0=Digit/10000;
	Digit=Digit-d0*10000;
	d1=Digit/1000;
	Digit=Digit-d1*1000;
	d2=Digit/100;
	Digit=Digit-d2*100;
	d3=Digit/10;
	Digit=Digit-d3*10;
	d4=Digit%10;
	
	xianshi1(d0,y,x+6+i);
	xianshi1(d1,y,x+(6+i)*2);
	xianshi1(d2,y,x+(6+i)*3);
	xianshi1(d3,y,x+(6+i)*4);
	xianshi1(d4,y,x+(6+i)*5);
}

void DisplayChar_16X08(uchar y,uchar x,char *dispdata)
{
	uchar i,j,fontposition,addyl,addyh;
	uchar *databuf;

	while((*dispdata)!=0)
	{
		//		if((y>127)||(x>7))	 break;						//判断字符显示的位置是否超出范围
		
		/*获取字符在字库中的位置*/
		fontposition=*dispdata-0x20;					//计算字符在字库中的位置
		databuf=(uchar *)(ASCII_1608+fontposition);
		
		/*计算当前字符显示的起始列地址*/
		addyl=y%16;										//计算列低地址
		addyh=y/16+0x10;								//计算列高地址

		/*显示字符*/
		for(i=0;i<2;i++)
		{
			OledWriteByte(0xb0+x+i,OLED_CMD);			//设置页地址
			OledWriteByte(addyl,OLED_CMD);				//设置列低地址
			OledWriteByte(addyh,OLED_CMD);				//设置列高地址

			for(j=0;j<8;j++)
			{
				OledWriteByte(*(databuf++),OLED_DATA);
			}
		}

		y+=8;											//列地址自加6
		dispdata++;
	}
}

/*****************************************************
** 函数名称：OledDispPicture
** 函数功能：指定位置显示任意大小图片（128*64内）
** 参    数：1.x: 图片显示的起始页地址
			 2.y：图片显示的起始列地址
			 3.width：图片宽度
			 4.fontlen：图片点阵总字节数
			 5.*picture：指向图片点阵数组
** 函数返回：无
******************************************************/
void OledDispPicture(uchar x,uchar y,uchar width,uint fontlen,uchar *picture)
{
	 uchar i,j,pagenum,addyl,addyh;

	 /*计算显示图像需要的参数*/
	 pagenum=fontlen/width;							//计算图像使用的页面数量
	 addyl=y%16;									//计算起始列低地址
	 addyh=y/16+0x10;									//计算起始列搞地质

	 /*显示图像*/
	 for(i=0;i<pagenum;i++)
	 {
		OledWriteByte(0xb0+x+i,OLED_CMD);			//设置页地址
		OledWriteByte(addyl,OLED_CMD);				//设置列低地址
		OledWriteByte(addyh,OLED_CMD);				//设置列高地址
		for(j=0;j<width;j++)
		{
			OledWriteByte(*(picture++),OLED_DATA);			
		}	
	 }
}